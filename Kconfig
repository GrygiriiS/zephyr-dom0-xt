## Kconfig
```kconfig
# Copyright (c) 2024 EPAM Systems
#
# SPDX-License-Identifier: Apache-2.0

config USE_DEFAULT_DOM_CFG
	bool "use default guest domain cfg"
	default y
	help
	  Use default guest domain cfg from domd_cfg.c for build.
	  if not selected the guest domain cfg source file will be selected as basing
	  on board/platform:
	    dom_cfg/${BOARD}.c.
	  For example, for RPI 5 the dom_cfg/rpi_5.c will be used.

config DOM_CFG_BOARD_EXT
	string "Use extention string to determine guest domain cfg"
	depends on !USE_DEFAULT_DOM_CFG
	help
	  Use it to add extention string to determine guest domain cfg file to build.
	  The guest domain cfg source file will be selected will be selected as following:
	    dom_cfg/${BOARD}_${DOM_CFG_BOARD_EXT}.c
	  This allows to specify number of guest domain configs for the same board.
	  For example:
	    rpi_5_xenvm.c
	    rpi_5_domd.c

config DOM_CFG_NUMBER
	int "Number of guest domain configs"
	default 1
	range 1 2
	help
	  Number of guest domain configs.

config DOM_CFG_DOMD_IMAGE_BIN_FILE
	string "Location for Domain-D kernel binary"
	default "domd_img.bin"

config DOM_CFG_DOMD_DTB_BIN_FILE
	string "Location for Domain-D device-tree"
	default "domd.dtb"

config DOM_CFG_DOMU1_IMAGE_BIN_FILE
	string "Location for Domain-U kernel binary"
	depends on DOM_CFG_NUMBER > 1
	default "domu_img.bin"

config DOM_CFG_DOMU1_DTB_BIN_FILE
	string "Location for Domain-U device-tree"
	depends on DOM_CFG_NUMBER > 1
	default "domu.dtb"

source "Kconfig.zephyr"
```

## west.yml
```yaml
# SPDX-License-Identifier: Apache-2.0
# West YAML manifest for Zephyr as Xen Dom0

manifest:
  self:
    path: zephyr-dom0-xt

  remotes:
    - name: xentroops
      url-base: https://github.com/xen-troops/
    - name: zephyrproject-rtos
      url-base: https://github.com/zephyrproject-rtos/
    - name: grag
      url-base: https://github.com/GrygiriiS/

  projects:
    - name: zephyr
      remote: grag
      revision: rpi5_dev_scmi_demo
      west-commands: scripts/west-commands.yml
    - name: zephyr-xenlib
      remote: xentroops
      revision: e3ec0d7cf3d9bd2a1c697234f4afaa0b53dea09c
    - name: fatfs
      remote: zephyrproject-rtos
      revision: 427159bf95ea49b7680facffaa29ad506b42709b
    - name: zephyr-xrun
      remote: xentroops
      revision: 5b6ecf274bac79b0be740693766a88d3eedf3b44
```
